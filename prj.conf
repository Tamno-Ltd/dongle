## CMakeLists.txt
```
cmake_minimum_required(VERSION 3.20.0)

find_package(Zephyr REQUIRED HINTS $ENV{ZEPHYR_BASE})

project(dongle)

if(NOT NCS_VERSION_MAJOR EQUAL 3 OR NOT NCS_VERSION_MINOR EQUAL 2 OR NCS_VERSION_PATCH LESS 3)
	message(FATAL_ERROR "Dongle requires NCS v3.2.3+, found v${NCS_VERSION}")
endif()

# cpuapp (application core) image: USB HID mouse + cpurad IPC receiver.
target_sources(app PRIVATE
	src/main.c
	usb/usb_hid.c
)

# Repo root for "usb/usb_hid.h"; include/ for the shared "dongle_ipc.h".
target_include_directories(app PRIVATE
	${CMAKE_CURRENT_SOURCE_DIR}
	${CMAKE_CURRENT_SOURCE_DIR}/include
)
```

## west.yml
```
manifest:
  remotes:
    - name: ncs
      url-base: https://github.com/nrfconnect
  projects:
    - name: nrf
      remote: ncs
      repo-path: sdk-nrf
      revision: v3.2.3
      import: true
```

## prj.conf
```kconfig
# --- Dongle cpuapp (application core) image ---
# USB HID mouse host-facing side. Receives 7-byte mouse reports from the
# cpurad ESB receiver over ICBMSG IPC and submits them to the USB host.

# --- USB device stack (new stack required for the nRF54H20 USBHS) ---
CONFIG_USB_DEVICE_STACK_NEXT=y
# Disable DWC2 DMA — nrf_desktop disables it for stability on nRF54H20.
CONFIG_UDC_DWC2_DMA=n
# VBUS ready timeout — keeps usbd_enable() from blocking forever with no cable.
CONFIG_UDC_DWC2_USBHS_VBUS_READY_TIMEOUT=100
# UDC buffer pool — default 1024 is too small; Windows issues control requests
# with wLength=4095 (MS OS descriptor probe) which fails allocation otherwise.
CONFIG_UDC_BUF_POOL_SIZE=8192
# Suppress per-packet USB protocol chatter — only show warnings/errors.
CONFIG_USBD_LOG_LEVEL_WRN=y
CONFIG_UDC_DRIVER_LOG_LEVEL_WRN=y

# --- Inter-core IPC to cpurad (ICBMSG) ---
# The ICBMSG backend auto-selects (default y) given MBOX + the cpuapp_cpurad_ipc
# DT node from the DK base DTS.
CONFIG_IPC_SERVICE=y
CONFIG_MBOX=y
# Boot cpurad at runtime so the cpuapp<->cpurad IPC endpoint can bind.
# Without this the radio core stays held in reset and the IPC bind times out.
CONFIG_SOC_NRF54H20_CPURAD_ENABLE=y

# --- RTT logging (cpuapp owns RTT; the radio core is headless) ---
CONFIG_LOG=y
CONFIG_LOG_DEFAULT_LEVEL=3
CONFIG_LOG_BACKEND_RTT=y
CONFIG_USE_SEGGER_RTT=y
CONFIG_SEGGER_RTT_BUFFER_SIZE_UP=4096

# Route printk() to RTT too, so both LOG_INF() and printk() are visible.
CONFIG_CONSOLE=y
CONFIG_RTT_CONSOLE=y
CONFIG_UART_CONSOLE=n
CONFIG_PRINTK=y
CONFIG_LOG_PRINTK=y

CONFIG_BOOT_BANNER=n
```

## boards/nrf54h20dk_nrf54h20_cpurad.conf
```kconfig
# Match the NCS esb_prx/esb_ptx cpurad board config: use the GPPI v0 path on
# nRF54H20. Diverging from this caused DPPI setup issues in tempo bringup.
CONFIG_NRFX_GPPI_V1=n
```

## boards/nrf54h20dk_nrf54h20_cpuapp.overlay
```dts
/*
 * Dongle USB HID mouse — cpuapp overlay.
 *
 * Declares the HID device that the new USB device stack binds to. The USBHS
 * controller (zephyr_udc0) is already enabled on cpuapp by the DK base DTS,
 * and the cpuapp<->cpurad ICBMSG instance (cpuapp_cpurad_ipc) plus its
 * bellboards are also provided by the DK base DTS, so no other nodes are
 * needed here.
 *
 * Report layout (7 bytes): buttons[2] + X[2] + Y[2] + wheel[1], matching the
 * dongle ESB on-air payload (include/dongle_ipc.h) and usb/usb_hid_report.h.
 */

/ {
	hid_dev_0: hid_dev_0 {
		compatible = "zephyr,hid-device";
		label = "HID0";
		protocol-code = "mouse";
		in-polling-period-us = <125>;
		in-report-size = <7>;
	};
};
```

## boards/nrf54h20dk_nrf54h20_cpurad.overlay
```dts
/*
 * Dongle ESB PRX cpurad overlay.
 *
 * Adds the devicetree nodes the ESB radio driver needs on nRF54H20 cpurad.
 * Mirrors the NCS esb_prx sample's cpurad overlay, minus the DK LED nodes
 * (this receiver has no LED code). The errata216 mboxes are the must-have:
 * both the NCS samples and the proven tempo radio app include them.
 */

/ {
	/* HMPAN-216 workaround: cpurad requests power-state changes from cpusys
	 * via VEVIF mboxes. Required by the ESB driver init on nRF54H20.
	 * Channels match the NCS esb_prx/esb_ptx samples and the tempo app.
	 */
	cpurad_cpusys_errata216_mboxes: errata216_mboxes {
		compatible = "zephyr,mbox-ipm";
		status = "okay";
		mboxes = <&cpusys_vevif 0x14>, <&cpusys_vevif 0x15>;
		mbox-names = "on_req", "off_req";
	};
};

/* Radio event routing used by the ESB driver on nRF54H20 (from the NCS
 * esb_prx sample's cpurad overlay).
 */
&gpiote130 {
	owned-channels = <0 1 2 3 4 5 6 7>;
	status = "okay";
};

&dppic020 {
	status = "okay";
	source-channels = <0 1 2 3 4 5>;
	sink-channels = <6 7 8 9 10 11>;
};
```

## src/main.c
```c
/*
 * Dongle USB HID mouse — cpuapp (application core).
 *
 * Receives 7-byte mouse reports from the radio core (cpurad ESB PRX) over the
 * cpuapp<->cpurad ICBMSG IPC link and submits them to the USB host as HID
 * mouse input reports, so the dongle enumerates in Windows Device Manager as a
 * HID-compliant mouse and moves the host cursor.
 *
 * Data flow:
 *   remote PTX --ESB--> cpurad PRX --IPC(dongle_mouse)--> cpuapp --USB HID--> PC
 *
 * The 7-byte report layout (buttons[2] LE + X[2] LE + Y[2] LE + wheel[1]) is
 * the single canonical format end to end (see include/dongle_ipc.h and
 * usb/usb_hid_report.h).
 */

#include <string.h>
#include <errno.h>

#include <zephyr/kernel.h>
#include <zephyr/device.h>
#include <zephyr/devicetree.h>
#include <zephyr/ipc/ipc_service.h>
#include <zephyr/sys/byteorder.h>
#include <zephyr/sys/atomic.h>
#include <zephyr/logging/log.h>
#include <zephyr/sys/printk.h>

#include "usb/usb_hid.h"
#include "dongle_ipc.h"

LOG_MODULE_REGISTER(dongle, LOG_LEVEL_INF);

/* ---- cpurad IPC link (ICBMSG, single named endpoint) ---- */

static K_SEM_DEFINE(radio_ipc_bound_sem, 0, 1);
static struct ipc_ept radio_ep;
static atomic_t reports_rx;
static atomic_t reports_dropped;

static void radio_ipc_bound(void *priv)
{
	ARG_UNUSED(priv);
	k_sem_give(&radio_ipc_bound_sem);
	LOG_INF("radio IPC endpoint bound");
}

static void radio_ipc_recv(const void *data, size_t len, void *priv)
{
	ARG_UNUSED(priv);

	if (len < 1) {
		return;
	}

	const uint8_t *raw = data;

	if (raw[0] != DONGLE_IPC_MOUSE_REPORT) {
		LOG_WRN("radio unknown IPC type=0x%02x len=%zu", raw[0], len);
		return;
	}

	if (len < sizeof(struct dongle_ipc_mouse_report)) {
		LOG_WRN("short mouse report len=%zu", len);
		return;
	}

	struct dongle_ipc_mouse_report msg;

	memcpy(&msg, data, sizeof(msg));

	uint16_t buttons = sys_get_le16(&msg.report[0]);
	int16_t  dx      = (int16_t)sys_get_le16(&msg.report[2]);
	int16_t  dy      = (int16_t)sys_get_le16(&msg.report[4]);
	int8_t   wheel   = (int8_t)msg.report[6];

	int ret = dongle_usb_submit_mouse_report(dx, dy, buttons, wheel);

	if (ret == 0) {
		atomic_inc(&reports_rx);
	} else {
		/* -EACCES until the host enumerates the HID interface (no cable
		 * / driver not bound yet) — expected, counted as a drop.
		 */
		atomic_inc(&reports_dropped);
		if (ret != -EACCES) {
			LOG_WRN("HID submit error: %d", ret);
		}
	}
}

static int radio_ipc_init(void)
{
	const struct device *ipc_dev =
		DEVICE_DT_GET(DT_NODELABEL(cpuapp_cpurad_ipc));

	static struct ipc_ept_cfg cfg = {
		.name = DONGLE_IPC_EPT_NAME,
		.cb = {
			.bound    = radio_ipc_bound,
			.received = radio_ipc_recv,
		},
	};

	if (!device_is_ready(ipc_dev)) {
		LOG_ERR("cpurad ICBMSG instance not ready");
		return -ENODEV;
	}

	int ret = ipc_service_open_instance(ipc_dev);

	if (ret < 0 && ret != -EALREADY) {
		LOG_ERR("ipc_service_open_instance: %d", ret);
		return ret;
	}

	ret = ipc_service_register_endpoint(ipc_dev, &radio_ep, &cfg);
	if (ret < 0) {
		LOG_ERR("ipc_service_register_endpoint: %d", ret);
		return ret;
	}

	ret = k_sem_take(&radio_ipc_bound_sem, K_SECONDS(10));
	if (ret < 0) {
		LOG_WRN("radio IPC bind timeout (cpurad link down)");
		return ret;
	}

	return 0;
}

int main(void)
{
	int err;

	LOG_INF("Dongle USB HID mouse starting (cpuapp)");
	printk("Dongle USB HID mouse starting (printk/RTT)\n");

	/* Bring up USB HID first so the host can enumerate the mouse early. */
	err = dongle_usb_init();
	if (err) {
		LOG_ERR("dongle_usb_init: %d", err);
		return 0;
	}

	err = dongle_usb_enable();
	if (err) {
		LOG_WRN("dongle_usb_enable: %d", err);
	}

	/* Bring up the cpurad IPC link that feeds mouse reports. */
	err = radio_ipc_init();
	if (err) {
		LOG_WRN("radio_ipc_init: %d (no mouse data from radio core)",
			err);
	}

	uint32_t prev = 0;

	while (1) {
		k_sleep(K_SECONDS(1));

		uint32_t now = atomic_get(&reports_rx);

		LOG_INF("alive: hid_tx=%u (+%u/s) dropped=%u",
			now, now - prev,
			(unsigned int)atomic_get(&reports_dropped));
		prev = now;
	}

	return 0;
}
```

## include/dongle_ipc.h
```c
/*
 * Dongle cpuapp <-> cpurad IPC contract (ICBMSG, single endpoint).
 *
 * Single source of truth for the inter-core mouse-report message, shared by
 * the cpuapp USB-HID app (src/main.c) and the cpurad ESB PRX app
 * (radio/src/main.c). Type-byte demux on one named endpoint.
 *
 * Direction (mirrors tempo's app/ipc/ipc_radio.h convention):
 *   0x20-0x2F  cpurad -> cpuapp
 */

#ifndef DONGLE_IPC_H_
#define DONGLE_IPC_H_

#include <stdint.h>

/* Endpoint name — must match byte-for-byte on both cores. */
#define DONGLE_IPC_EPT_NAME		"dongle_mouse"

/* cpurad -> cpuapp message types. */
#define DONGLE_IPC_MOUSE_REPORT		0x20

/*
 * Canonical mouse-report payload size: the 7-byte USB HID mouse report layout
 * used end to end (ESB on-air -> IPC -> USB HID). The remote transmitter sends
 * exactly these 7 bytes; cpurad forwards them unmodified; cpuapp decodes them
 * and submits a HID report. See usb/usb_hid_report.h for the matching encoder.
 *
 *   bytes 0-1  buttons  (uint16, little-endian, bit 0 = button 1 / LMB)
 *   bytes 2-3  X delta  (int16,  little-endian, relative)
 *   bytes 4-5  Y delta  (int16,  little-endian, relative)
 *   byte  6    wheel    (int8,   relative)
 */
#define DONGLE_MOUSE_REPORT_SIZE	7

/* cpurad -> cpuapp: one HID mouse report received over ESB. */
struct dongle_ipc_mouse_report {
	uint8_t type;				/* DONGLE_IPC_MOUSE_REPORT */
	uint8_t len;				/* valid bytes in report[] (= 7) */
	uint8_t report[DONGLE_MOUSE_REPORT_SIZE];
};  /* 9 bytes */

#endif /* DONGLE_IPC_H_ */
```
